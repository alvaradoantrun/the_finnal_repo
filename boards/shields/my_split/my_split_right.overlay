/ {
    chosen { zmk,keyboard = &kb_right; };
};

&pro_micro {
    status = "okay";
};

kb_right: kb_right {
    compatible = "zmk,keyboard";
    label = "MY_SPLIT_RIGHT";
    matrix-transform = &mt_right;
};

&kscan0 {
    status = "okay";
    diode-direction = "ROW2COL";
    row-gpios = <&gpio0 9 0>, <&gpio0 10 0>, <&gpio1 11 0>, <&gpio1 13 0>, <&gpio1 15 0>, <&gpio0 2 0>;
    col-gpios = <&gpio1 6 0>, <&gpio1 4 0>, <&gpio0 11 0>, <&gpio1 0 0>, <&gpio0 24 0>, <&gpio0 22 0>, <&gpio0 20 0>;
};

mt_right: matrix_transform {
    compatible = "zmk,matrix-transform";
    rows = <6>;
    columns = <7>;
};

&default_central { status = "okay"; };
